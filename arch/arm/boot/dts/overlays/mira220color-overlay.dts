// SPDX-License-Identifier: GPL-2.0-only
// Definitions for MIRA220 camera module on VC I2C bus
/dts-v1/;
/plugin/;

#include <dt-bindings/gpio/gpio.h>
#include "mira220_mono_color-overlay.dtsi"

&mira220 {
        compatible = "ams,mira220color";
	reg-name = "mira220color";
};

