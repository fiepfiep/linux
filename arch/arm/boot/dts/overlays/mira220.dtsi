// SPDX-License-Identifier: GPL-2.0-only
// Definitions for MIRA220 camera module on VC I2C bus


//#include <dt-bindings/gpio/gpio.h>
//#include "mira220_mono_color-overlay.dtsi"
//
//&mira220 {
//        compatible = "ams,mira220";
//	reg-name = "mira220";
//};


// Fragment that configures an mira220

cam_node: mira220@10 {
	compatible = "ams,mira220";
	reg = <0x54>;
	status = "disabled";

	clocks = <&cam1_clk>;
	clock-names = "xclk";

	VANA-supply = <&cam1_reg>;	/* 2.8v */
	VDIG-supply = <&cam_dummy_reg>;	/* 1.8v */
	VDDL-supply = <&cam_dummy_reg>;	/* 1.2v */

	rotation = <0>;
	orientation = <2>;

	port {
		cam_endpoint: endpoint {
			clock-lanes = <0>;
			data-lanes = <1 2>;
			// clock-noncontinuous;
			link-frequencies =
				/bits/ 64 <456000000>;
		};
	};
};
